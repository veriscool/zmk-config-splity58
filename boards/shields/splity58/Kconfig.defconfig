## boards/shields/splity58/Kconfig.defconfig
```kconfig
if SHIELD_CENTRAL_DONGLE

# Max 16 characters in keyboard name
config ZMK_KEYBOARD_NAME
    default "splity58"

config ZMK_SPLIT_ROLE_CENTRAL
    default y

choice ZMK_DISPLAY_STATUS_SCREEN
    default ZMK_DISPLAY_STATUS_SCREEN_CUSTOM
endchoice

config ZMK_DISPLAY_STATUS_SCREEN_CUSTOM
    select ZMK_WPM
    imply ZMK_HID_INDICATORS

choice ZMK_DISPLAY_WORK_QUEUE
    default ZMK_DISPLAY_WORK_QUEUE_DEDICATED
endchoice

config LV_Z_VDB_SIZE
	default 64
    
config LV_DPI_DEF
    default 148

config LV_Z_BITS_PER_PIXEL
    default 16

choice ST7789V_PIXEL_FORMAT
    default ST7789V_RGB565
endchoice

choice LV_COLOR_DEPTH
    default LV_COLOR_DEPTH_16
endchoice


endif

if SHIELD_SPLITY58_LEFT || SHIELD_SPLITY58_RIGHT || SHIELD_CENTRAL_DONGLE

config ZMK_SPLIT
    default y

endif
```

## boards/shields/splity58/Kconfig.shield
```kconfig
config SHIELD_SPLITY58_LEFT
    def_bool $(shields_list_contains,splity58_left)
  
config SHIELD_SPLITY58_RIGHT
    def_bool $(shields_list_contains,splity58_right)

config SHIELD_SPLITY58_DONGLE
    def_bool $(shields_list_contains,splity58_dongle)
  
```

## config/west.yml
```yaml
manifest:
  defaults:
    revision: v0.3
  remotes:
    - name: zmkfirmware
      url-base: https://github.com/zmkfirmware
    # Additional modules containing boards/shields/custom code can be listed here as well
    # See https://docs.zephyrproject.org/3.2.0/develop/west/manifest.html#projects
    - name: caksoylar  # <-- new entry
      url-base: https://github.com/caksoylar
    - name: joaopedropio                          # <--- add these
      url-base: https://github.com/joaopedropio
  projects:
    - name: zmk
      remote: zmkfirmware
      import: app/west.yml
    - name: zmk-rgbled-widget  # <-- new entry
      remote: caksoylar
      revision: main
    - name: snake-module                          # <--- and these
      remote: joaopedropio                        # <---
      revision: master
  self:
    path: config
```
